## conf/layer.conf
```bitbake
# We have a conf and classes directory, add to BBPATH
BBPATH .= ":${LAYERDIR}"

# We have recipes-* directories, add to BBFILES
BBFILES += "${LAYERDIR}/recipes-core/packagegroup-oss-docker.bb"

BBFILE_COLLECTIONS += "native-prebuilt-generator"
BBFILE_PATTERN_native-prebuilt-generator = "^${LAYERDIR}/"
BBFILE_PRIORITY_native-prebuilt-generator = "6"

LAYERDEPENDS_native-prebuilt-generator = "core"
LAYERSERIES_COMPAT_native-prebuilt-generator = "dunfell kirkstone"

D_ARCH_VARIANT ?= "arm7a"

BBMULTICONFIG ?= "arm7ve arm64"

TMPDIR ?= "${TOPDIR}/tmp-${D_ARCH_VARIANT}"
BUILDHISTORY_DIR ?= "${TOPDIR}/buildhistory-${D_ARCH_VARIANT}"

GENERATE_NATIVE_PKG_PREBUILT = "1"
```
